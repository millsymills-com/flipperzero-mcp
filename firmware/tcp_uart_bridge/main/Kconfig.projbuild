## firmware/tcp_uart_bridge/main/Kconfig.projbuild
```kconfig
menu "TCP-UART Bridge Configuration"

    config BRIDGE_TCP_PORT
        int "TCP Server Port"
        default 8080
        help
            Port number for the TCP server that clients connect to.

    config BRIDGE_UART_BAUD_RATE
        int "UART Baud Rate"
        default 230400
        help
            Target baud rate for Flipper Expansion Protocol after negotiation.

    config BRIDGE_UART_TX_PIN
        int "UART TX GPIO Pin"
        default 43
        help
            GPIO pin for UART TX (connects to Flipper RX pin 14).

    config BRIDGE_UART_RX_PIN
        int "UART RX GPIO Pin"
        default 44
        help
            GPIO pin for UART RX (connects to Flipper TX pin 13).

    config BRIDGE_AP_SSID
        string "Captive Portal AP SSID"
        default "FlipperBridge"
        help
            SSID for the configuration captive portal.

    config BRIDGE_AP_PASSWORD
        string "Captive Portal AP Password"
        default ""
        help
            Password for the configuration captive portal (min 8 chars).
            Set this before flashing; the firmware rejects passwords under
            8 characters.

    config BRIDGE_MAX_CLIENTS
        int "Maximum TCP Clients"
        default 1
        help
            Maximum number of simultaneous TCP client connections.

endmenu
```

## firmware/tcp_uart_bridge/sdkconfig.defaults
```kconfig
# TCP-UART Bridge SDK Configuration Defaults

# Target ESP32-S2 (Flipper WiFi Dev Board)
CONFIG_IDF_TARGET="esp32s2"

# Bridge settings
CONFIG_BRIDGE_TCP_PORT=8080
CONFIG_BRIDGE_UART_BAUD_RATE=115200
CONFIG_BRIDGE_UART_TX_PIN=43
CONFIG_BRIDGE_UART_RX_PIN=44
# Set a captive-portal AP password (min 8 chars) before flashing.
CONFIG_BRIDGE_AP_SSID="FlipperBridge"
CONFIG_BRIDGE_AP_PASSWORD=""
CONFIG_BRIDGE_MAX_CLIENTS=1

# WiFi settings
CONFIG_ESP_WIFI_SSID=""
CONFIG_ESP_WIFI_PASSWORD=""

# Increase task stack sizes for networking
CONFIG_ESP_MAIN_TASK_STACK_SIZE=4096
CONFIG_LWIP_TCPIP_TASK_STACK_SIZE=3072

# Enable mDNS for easy discovery
CONFIG_MDNS_STRICT_MODE=n

# NVS for storing WiFi credentials
CONFIG_NVS_ENCRYPTION=n

# HTTP Server settings
CONFIG_HTTPD_MAX_REQ_HDR_LEN=1024
CONFIG_HTTPD_MAX_URI_LEN=512

# Partition table
CONFIG_PARTITION_TABLE_CUSTOM=y
CONFIG_PARTITION_TABLE_CUSTOM_FILENAME="partitions.csv"

# Log level
CONFIG_LOG_DEFAULT_LEVEL_INFO=y
CONFIG_LOG_MAXIMUM_LEVEL_DEBUG=y
```
